## conf/layer.conf
```bitbake
# We have a conf and classes directory, add to BBPATH
BBPATH .= ":${LAYERDIR}"

# We have recipes-* directories, add to BBFILES
BBFILES += "${LAYERDIR}/recipes-*/*/*.bb \
            ${LAYERDIR}/recipes-*/*/*.bbappend"

BBFILE_COLLECTIONS += "meta-firewire-recorder"
BBFILE_PATTERN_meta-firewire-recorder = "^${LAYERDIR}/"
BBFILE_PRIORITY_meta-firewire-recorder = "9"

LAYERDEPENDS_meta-firewire-recorder = "core"
LAYERSERIES_COMPAT_meta-firewire-recorder = "wrynose"
INIT_MANAGER = "systemd"

# ffmpeg and x264 in oe-core are tagged commercial.
LICENSE_FLAGS_ACCEPTED:append = " commercial"
```
